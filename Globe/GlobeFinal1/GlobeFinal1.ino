#include <ESP8266HTTPClient.h>
#include <ESP8266WiFi.h>
#include <WiFiClient.h>
#include <ESP8266WebServer.h>
#include <ESP8266mDNS.h>
#include <FastLED.h>

const char* ssid = "DragonHack";
const char* password = "goodh4ck";

int clong = 0;
int clat = 0;

ESP8266WebServer server(80);

int strength = 255;

#define NUM_LEDS 72
CRGB leds[NUM_LEDS];

byte anzahl_register = 9; // Number of registers
byte sectoren = 150;    //   Number of segments per rotation
byte byte_register [9][150] = {
 {0 , 0 , 0 , 0 , 0 , 0 , 0 , 0 , 0 , 0 , 0 , 0 , 0 ,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 0 , 0},
 {0 , 0 , 13 , 15 , 15 , 15 , 15 , 15 , 15 , 15 , 15 , 15 , 15 ,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 0 , 0},
 {0 , 0 , 96 , 224 , 240 , 240 , 240 , 224 , 224 , 192 , 192 , 192 , 224 ,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 0 , 0},
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 {0 , 0 , 0 , 0 , 0 , 0 , 0 , 0 , 0 , 0 , 0 , 0 , 0 ,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 0 , 0}
};

//byte anzahl_register = 9; // Number of registers
//byte sectoren = 150;       Number of segments per rotation
byte byte_register_test [9][150] = {
 {255 , 64 , 32 , 16 , 8 , 4 , 2 , 1 , 0 , 0 , 0 , 0 , 0 ,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 255 , 255},
 {255 , 0 , 0 , 0 , 0 , 0 , 0 , 0 , 128 , 64 , 32 , 16 , 8 ,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 255 , 255},
 {255 , 0 , 0 , 0 , 0 , 0 , 0 , 0 , 0 , 0 , 0 , 0 , 0 ,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 255 , 255},
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 {255 , 0 , 0 , 0 , 0 , 0 , 0 , 0 , 0 , 0 , 0 , 0 , 0 ,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 255 , 255}
};



void handleRoot() {
  server.send(200, "text/plain", "hello from esp8266!");
}

void handleNotFound(){
  String message = "File Not Found\n\n";
  message += "URI: "; message += server.uri(); message += "\nMethod: "; 
  message += (server.method() == HTTP_GET)?"GET":"POST"; message += "\nArguments: "; message += server.args();
  message += "\n";
  for (uint8_t i=0; i<server.args(); i++){ message += " " + server.argName(i) + ": " + server.arg(i) + "\n"; }
  server.send(404, "text/plain", message);
}

void handleBody() { //Handler for the body path
  String message = "Number of args received:";
  message += server.args();            //Get number of parameters
  message += "\n"; 
  for (int i = 0; i < server.args(); i++) {
    message += "Arg n" + (String)i + " -> ";   //Include the current iteration value
    message += server.argName(i) + ": ";     //Get the name of the parameter
    message += server.arg(i) + "\n";              //Get the value of the parameter
  }
  if (server.arg("lat")!= ""){     //Parameter not found
    message = "lat = ";
    clat = server.arg("lat").toInt();     //Gets the value of the query parameter
   }
  if (server.arg("lon")!= ""){     //Parameter not found
    message = "Tlon = ";
    clong = server.arg("lon").toInt();     //Gets the value of the query parameter
   }
  Serial.print("lat, lon");
  Serial.print(clat); Serial.print(", ");
  Serial.print(clong); Serial.print("\n");
  server.send(200, "text/plain", message);       //Response to the HTTP request
}

void setup(void){
  FastLED.addLeds<WS2812B, 
  14>(leds, NUM_LEDS); 
  
  Serial.begin(115200);
  WiFi.begin(ssid, password);
  Serial.println("");

  // Wait for connection
  while (WiFi.status() != WL_CONNECTED) {
    delay(500);
    Serial.print(".");
  }
  if(WiFi.status()== WL_CONNECTED){   //Check WiFi connection status
   HTTPClient http;    //Declare object of class HTTPClient
   //http.begin("http://dragon.kolman.si/alexa/arduino?ip=" + WiFi.localIP());      //Specify request destination
   http.begin("http://193.2.177.45:8000/alexa/arduino?ip=" + WiFi.localIP().toString()); // + WiFi.localIP());      //Specify request destination
   http.addHeader("Content-Type", "text/plain");  //Specify content-type header
   int httpCode = http.GET();   //Send the request
   String payload = http.getString();                  //Get the response payload
   Serial.println("Http code and payload");
   Serial.println(httpCode);   //Print HTTP return code
   Serial.println(payload);    //Print request response payload
   
   http.end();  //Close connection
 }
  Serial.println("");
  Serial.print("Connected to ");
  Serial.println(ssid);
  Serial.print("IP address: ");
  Serial.println(WiFi.localIP());

  if (MDNS.begin("esp8266")) {
    Serial.println("MDNS responder started");
  }
  server.on("/", handleRoot);
  server.on("/inline", [](){
    server.send(200, "text/plain", "this works as well");
  });
  server.onNotFound(handleNotFound);
  server.on("/body", handleBody);
  server.begin();
  Serial.println("HTTP server started");
}

void loop(void){
  for (int i = 0; i < sectoren; i++){
    for (int k = 0; k < anzahl_register; k++){
      byte wholec = byte_register[k][i];
      for (int j = 0; j < 8; j++){
        int ccol = (wholec & 1)*strength;
        leds[NUM_LEDS - 1 - (j + (anzahl_register-k-1)*8)] = CRGB( ccol, 0, 0);
        //if (clong == i && clat == j + (3-k)*8){
        if (abs(clong - i) < 2 && clat == j + (3-k)*8){
          leds[j + (3-k)*8] = CRGB( 0, 255, 0);
        }
        wholec >>= 1;
      }
    }
    FastLED.show();
    //delayMicroseconds(100);
 }
  
  server.handleClient();
}
